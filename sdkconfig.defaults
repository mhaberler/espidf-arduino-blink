## sdkconfig.defaults
```kconfig
CONFIG_AUTOSTART_ARDUINO=y
CONFIG_FREERTOS_HZ=1000

# needed for boards/waveshare-ESP32-S3-DEV-KIT-N8R8.json :
CONFIG_ESP32S3_DEFAULT_CPU_FREQ_240=y
CONFIG_ESP32S3_SPIRAM_SUPPORT=y
#CONFIG_SPIRAM_MODE_OCT=y
CONFIG_SPIRAM_SPEED_80M=y
CONFIG_SPIRAM_IGNORE_NOTFOUND=y
CONFIG_LOG_DEFAULT_LEVEL_DEBUG=y

#CONFIG_ESP_TASK_WDT=n
#CONFIG_ESP_INT_WDT=n
```
